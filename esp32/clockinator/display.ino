  const int iconSize = 64;
#include "globals.h"
#include <GxEPD2_BW.h>
#include <Preferences.h>
#include "DisplayRefreshPolicy.h"

static DisplayRefreshPolicy refreshPolicy;
static unsigned refreshMinutes = 0;
#include <Fonts/FreeMonoBold12pt7b.h>


// The screen pins
#define EPD_CS   5
#define EPD_DC   16
#define EPD_RST  17
#define EPD_BUSY 4

// Text properties
#define SHOW_TEXT_SIZE  1
#define CLOCK_SIZE      13
#define ALARM_TEXT_SIZE 3


// Icons 48x48, 288 bytes
const uint8_t ICON_WIFI[] PROGMEM = {
    0x00, 0x00, 0x00, 0x00, 0x00, 0x00, 0x00, 0x00, 0x00, 0x00, 0x00, 0x00,
    0x00, 0x00, 0x00, 0x00, 0x00, 0x00, 0x00, 0x00, 0x00, 0x00, 0x00, 0x00,
    0x00, 0x00, 0x00, 0x00, 0x00, 0x00, 0x00, 0x00, 0x00, 0x00, 0x00, 0x00,
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    0x00, 0x00, 0x00, 0x00, 0x00, 0x00, 0x00, 0x00, 0x00, 0x00, 0x00, 0x00,
};
const uint8_t ICON_BLUETOOTH[] PROGMEM = {
    0x00, 0x00, 0x01, 0x80, 0x00, 0x00, 0x00, 0x00, 0x03, 0xC0, 0x00, 0x00,
    0x00, 0x00, 0x03, 0xE0, 0x00, 0x00, 0x00, 0x00, 0x03, 0xF0, 0x00, 0x00,
    0x00, 0x00, 0x03, 0xFC, 0x00, 0x00, 0x00, 0x00, 0x03, 0xFE, 0x00, 0x00,
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    0x00, 0x00, 0x03, 0xC0, 0x00, 0x00, 0x00, 0x00, 0x01, 0x80, 0x00, 0x00,
};




// This bool is used to check if we alternated between drawing clock to raw messages by saving false in the show function and true in the drawClock
// This can be used to force a full screen redraw only when needed.
bool was_previously_drawing = false; 

// The variable to manipulate to interact with the screen
GxEPD2_BW<GxEPD2_370_GDEY037T03, GxEPD2_370_GDEY037T03::HEIGHT> display(
  GxEPD2_370_GDEY037T03(
      EPD_CS,
      EPD_DC,
      EPD_RST,
      EPD_BUSY
  )
);

void initDisplay(){
  Preferences prefs;
  prefs.begin("display", true);
  refreshMinutes = prefs.getUInt("refreshMinutes", 0);
  prefs.end();
  if (refreshMinutes > 1440) refreshMinutes = 0;
  refreshPolicy.setMinutes(refreshMinutes);
  display.init(115200);
  display.setRotation(1); // Landscape
}


void show(const char* line1){
  show(line1, "");
}

void show(const char *line1, const char *line2) {
    display.setFullWindow();
    display.firstPage();
    display.setTextSize(SHOW_TEXT_SIZE);
    do {
        display.fillScreen(GxEPD_WHITE);
        display.setTextColor(GxEPD_BLACK);
        display.setFont(&FreeMonoBold12pt7b);

        display.setCursor(10, 50);
        display.print(line1);

        display.setCursor(10, 90);
        display.print(line2);

    } while (display.nextPage());

    was_previously_drawing = false;
}

static bool fullClockRefreshRequested = true;
time_t lastClockMinute = -1;

void requestFullClockRefresh() { fullClockRefreshRequested = true; }
void queueInitialClockRefresh() { refreshPolicy.synchronized(millis()); }
void noteClockLinkChange() { refreshPolicy.linkChanged(millis()); }
void setDisplayRefreshMinutes(unsigned minutes) {
  if (minutes > 1440 || minutes == refreshMinutes) return;
  refreshMinutes = minutes;
  refreshPolicy.setMinutes(minutes);
  Preferences prefs;
  prefs.begin("display", false);
  prefs.putUInt("refreshMinutes", minutes);
  prefs.end();
}
void serviceClockRefresh() {
  if (refreshPolicy.due(millis(), clockConnectionsReadyForRefresh())) {
    requestFullClockRefresh();
    drawClock();
  }
}

void drawClock() {

  time_t now = start_time + (millis() / 1000);

  struct tm timeinfo;
  localtime_r(&now, &timeinfo);

  char buffer[6];
  strftime(buffer, sizeof(buffer), "%H:%M", &timeinfo);
  if (start_time == 0) strcpy(buffer, "--:--");

  // If previous use of the display was to draw a raw message then we redraw everything
  // otherwise partial redraw
  const bool fullRefresh = !was_previously_drawing || fullClockRefreshRequested;
  if (fullRefresh){
    display.setFullWindow();
  }
  else {
    display.setPartialWindow(0, 0, display.width(), display.height());
  }

  display.firstPage();

  do {

    // General screen settings
    display.fillScreen(GxEPD_WHITE);
    display.setTextColor(GxEPD_BLACK);
    display.setFont(NULL);

    // Displaying current time
    display.setTextSize(CLOCK_SIZE);
    display.setCursor(20, 50);
    display.print(buffer);

    // Now writing the next alarm at the bottom
    display.setTextSize(ALARM_TEXT_SIZE);
    display.setCursor(10, 174);

    if (next_alarm > 0) {
      char alarm_buff[13];
      struct tm alarm_timeinfo;
      localtime_r(&next_alarm, &alarm_timeinfo);
      strftime(alarm_buff, sizeof(alarm_buff), "Alarm: %H:%M", &alarm_timeinfo);
      display.print(alarm_buff);
    }
    else {
      display.print("No alarm set");
    }

    display.setTextSize(2);
    display.setCursor(10, display.height() - 25);
    display.print("Vol ");
    for (int level = 1; level <= 5; ++level) {
      const int h = level * 4;
      const int x = 115 + (level - 1) * 14;
      const int y = display.height() - 9 - h;
      if (level <= getAlarmVolume()) display.fillRect(x, y, 10, h, GxEPD_BLACK);
      else display.drawRect(x, y, 10, h, GxEPD_BLACK);
    }

      // Draw the client state
      const int iconSize = 48;
      const int iconY = 190;
      const int bluetoothX = display.width() - iconSize ;
      const int wifiX = bluetoothX - iconSize;

    // Draw the active wireless links inside the panel bounds.
    if (is_wifi_connected){
      // Solid four-pixel arcs stay legible on the e-paper panel.
      const int cx = wifiX + 24, cy = iconY + 32;
      display.fillCircle(cx, cy, 22, GxEPD_BLACK);
      display.fillCircle(cx, cy, 18, GxEPD_WHITE);
      display.fillCircle(cx, cy, 13, GxEPD_BLACK);
      display.fillCircle(cx, cy, 9, GxEPD_WHITE);
      // The circles extend beyond the icon and the panel's bottom edge.
      // Clear all remaining rows before drawing the dot, including rows 238/239.
      display.fillRect(wifiX, cy, iconSize, display.height() - cy, GxEPD_WHITE);
      display.fillCircle(cx, cy + 7, 3, GxEPD_BLACK);
    }
    if (is_bluetooth_connected){
      display.drawBitmap(bluetoothX, iconY, ICON_BLUETOOTH, iconSize, iconSize, GxEPD_BLACK);
    }

  } while (display.nextPage());

  was_previously_drawing = true;
  lastClockMinute = now / 60;
  fullClockRefreshRequested = false;
  if (fullRefresh) refreshPolicy.refreshed(millis(), clockConnectionsReadyForRefresh());
}


